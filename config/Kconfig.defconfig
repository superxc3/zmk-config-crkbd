## config/Kconfig.defconfig
```kconfig
if SHIELD_CORNE_RIGHT

config ZMK_KEYBOARD_NAME
    default "Corne Right"

config ZMK_SPLIT_BLE_ROLE_CENTRAL
	default y
    
endif

if SHIELD_CORNE_LEFT || SHIELD_CORNE_RIGHT

config ZMK_SPLIT
    default y

endif
```
